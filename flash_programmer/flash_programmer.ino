
const int CE = 5;
const int WE = 3;
const int OE = 4;
const int stdDelay = 1;

const int CHIP_ERASE_ADD_SEQUENCE[6] = {0x5555, 0x2AAA, 0x5555, 0x5555, 0x2AAA, 0x5555}; 
const int CHIP_ERASE_DAT_SEQUENCE[6] = {0xAA, 0x55, 0x80, 0xAA, 0x55, 0x10};

const int BYTE_PROGRAM_ADD_SEQUENCE[3] = {0x5555, 0x2AAA, 0x5555};
const int BYTE_PROGRAM_DAT_SEQUENCE[3] = {0xAA, 0x55, 0xA0};

const int DEVICE_ID_ADD_SEQUENCE[3] = {0x5555, 0x2AAA, 0x5555};
const int DEVICE_ID_DAT_SEQUENCE[3] = {0xAA, 0x55, 0x90};

const int DEVICE_EXIT_ADD_SEQUENCE[3] = {0x5555, 0x2AAA, 0x5555};
const int DEVICE_EXIT_DAT_SEQUENCE[3] = {0xAA, 0x55, 0xF0};

const unsigned long START_ADD = 0xE000;
const int FLASH_SIZE = 1024;
const uint8_t ROM[1024] = {
0xFE, 0xA0, 0x00, 0x6E, 0x00, 0x8D, 0x40, 0x6E, 0x00, 0x10, 0x16, 0x04, 0xBD, 0xE3, 0x34, 0x8D,
0x67, 0x81, 0x53, 0x26, 0xFA, 0x8D, 0x61, 0x81, 0x39, 0x27, 0x29, 0x81, 0x31, 0x26, 0xF0, 0x7F,
0xA0, 0x0F, 0x8D, 0x31, 0x80, 0x02, 0xB7, 0xA0, 0x47, 0x8D, 0x1C, 0x8D, 0x28, 0x7A, 0xA0, 0x47,
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0xE3, 0x1A, 0x4C, 0xE0, 0x0C, 0x45, 0xE3, 0x1E, 0xE0, 0x00, 0xE1, 0x8B, 0xE1, 0xA7, 0xE0, 0xD0};

uint8_t progmem_temp;


void setup() {
	

}

void loop() {
        DDRA=B11111111;
	DDRC=B11111111;
	DDRL=B00000000;

	pinMode(CE, OUTPUT);
	pinMode(WE, OUTPUT);
	pinMode(OE, OUTPUT);
	digitalWrite(CE, HIGH);
	digitalWrite(WE, HIGH);
	digitalWrite(OE, HIGH);

	Serial.begin(115200);
	PORTA=0;
	PORTC=0;

	delay(2000);
        readDeviceID();
        Serial.println("Erasing Chip");
        chipErase();
        delay(100);
        Serial.println("Erasing Chip Done");
        Serial.print("Programming ");
        Serial.print(FLASH_SIZE);
        Serial.print(" bytes starting at address ");
        Serial.println(START_ADD);
	for (unsigned int i = 0; i < FLASH_SIZE; i++)
	{
                progmem_temp = ROM[i];
		Serial.print("Writing byte: ");
                Serial.print(progmem_temp);
                Serial.print(" at address: ");
		Serial.print(START_ADD + i);
		Serial.print("\n");
		programByte((START_ADD + i) / 256, (START_ADD + i) % 256, progmem_temp);
	}
        PORTA=0;
	PORTC=0;
	for (unsigned int i = 0; i < FLASH_SIZE; i++)
	{  
                uint8_t msb = (START_ADD + i) / 256;
                uint8_t lsb = (START_ADD + i) % 256;
		Serial.print("Testing byte address: ");
		Serial.print(msb);
                Serial.print(" ");
                Serial.print(lsb);
		Serial.print(" with data: ");
                uint8_t result = read(msb, lsb);
		Serial.print(ROM[i]);
		Serial.print(" result: ");
		Serial.print(result);
		if (ROM[i] == result) {
                  Serial.print(" PASS\n");
                } else {
                  Serial.println(" FAIL");
                }
	}
        while(1){}
}

uint8_t read(uint8_t msb, uint8_t lsb) {
	DDRL=B00000000;
	uint8_t eepromtest;
	PORTC = msb;
	PORTA = lsb;
	digitalWrite(CE, LOW);
	digitalWrite(OE, LOW);
        delay(stdDelay);
	eepromtest = PINL;
        digitalWrite(OE,HIGH);
	digitalWrite(CE, HIGH);
	return eepromtest;
} 

void write(uint8_t msb, uint8_t lsb, uint8_t bytes) {
	PORTC = msb;
	PORTA = lsb;
	DDRL = B11111111;
	PORTL = bytes;
	delay(stdDelay);
	digitalWrite(OE, HIGH);
	digitalWrite(CE, LOW);
	digitalWrite(WE, LOW);
	delay(stdDelay);
	digitalWrite(WE, HIGH);
	digitalWrite(CE, HIGH);
	DDRL=B00000000;
}

void chipErase() {
  for (int i = 0; i < 6; i++) {
    write(CHIP_ERASE_ADD_SEQUENCE[i]/256,CHIP_ERASE_ADD_SEQUENCE[i]%256,CHIP_ERASE_DAT_SEQUENCE[i]);
  }
}

void programByte(uint8_t msb, uint8_t lsb, uint8_t bytes) {
  for (int i = 0; i < 3; i++) {
    write(BYTE_PROGRAM_ADD_SEQUENCE[i]/256,BYTE_PROGRAM_ADD_SEQUENCE[i]%256,BYTE_PROGRAM_DAT_SEQUENCE[i]);
  }
  write(msb,lsb,bytes);
}

void readDeviceID() {
  for (int i = 0; i < 3; i++) {
    write(DEVICE_ID_ADD_SEQUENCE[i]/256, DEVICE_ID_ADD_SEQUENCE[i]%256, DEVICE_ID_DAT_SEQUENCE[i]);
  }
  uint8_t manufacturer = read(0, 0);
  uint8_t id = read(0, 1);
  for (int i = 0; i < 3; i++) {
    write(DEVICE_EXIT_ADD_SEQUENCE[i]/256, DEVICE_EXIT_ADD_SEQUENCE[i]%256, DEVICE_EXIT_DAT_SEQUENCE[i]);
  }
  Serial.print("manufacturer: ");
  Serial.print(manufacturer);
  Serial.print(" id: ");
  Serial.println(id);
}
