/* Standalone SWTPC simulator for Arduino Due. Bela Torok June 2014

   This software is the Aduino DUE port of the SIMH http://simh.trailing-edge.com SWTPC 
   simulator developed by William Beech.
   The CPU emulation is a nearly 1:1 implementation of file m6800.c in the SIMH package,
   the rest of the code is nearly a complete rewrite of the code for standalone operation.
   
   Memory map (Hexadecimal Addresses):
   0000-7FFF: RAM
   8004-8007: MC6850 ACIA (UART)
   A000-DFFF: RAM
   E000-FFFF: SWTBUG Monitor ROM (visible on every 1 k memory location)
   
   Emulated components:
   Motorola MC6800 CPU (SWTPC mp-a) 
   Motorola MC6850 UART (SWTPC mp-s)
   48k RAM

   The dc-4 disk controller is not implemented! 
   
   TCS 8k Basic, is preloaded to memory location (Hex) 0100
   TSC 8k Basic program and documentation are available from: http://www.flexusergroup.com/flexusergroup/fug4.htm
   To start Basic type either G (uppercase G) or J 0100 on the SWTBUG command line.
   To exit from Basic interpreter type exit.
   
   SWTBUG accepts only UPPER case letters as commands.
   TCS basic is lower case letter compatible. 
*/

#include <stdio.h>
#include <stdint.h>
#include "m6800.h"
#include "SWTPC.h"

#define MC6850_RTS 2

// Allocate arrays for RAM, ROM and memory mapped I/O devices
unsigned char SWTBUG_E000_FFFF[1024] = {
0xFE, 0xA0, 0x00, 0x6E, 0x00, 0x8D, 0x40, 0x6E, 0x00, 0x10, 0x16, 0x04, 0xBD, 0xE3, 0x34, 0x8D,
0x67, 0x81, 0x53, 0x26, 0xFA, 0x8D, 0x61, 0x81, 0x39, 0x27, 0x29, 0x81, 0x31, 0x26, 0xF0, 0x7F,
0xA0, 0x0F, 0x8D, 0x31, 0x80, 0x02, 0xB7, 0xA0, 0x47, 0x8D, 0x1C, 0x8D, 0x28, 0x7A, 0xA0, 0x47,
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0xE3, 0x1A, 0x4C, 0xE0, 0x0C, 0x45, 0xE3, 0x1E, 0xE0, 0x00, 0xE1, 0x8B, 0xE1, 0xA7, 0xE0, 0xD0};

unsigned char RAM_0000_7FFF[0x8000] = {
// TCS Basic, program and documentation are available from: http://www.flexusergroup.com/flexusergroup/fug4.htm
// It has known bugs, e.g., PRINT 3.14159*81 returns 921.135 (incorrect), however 
// PRINT 3.14159*81.0001 returns 254.469 (correct)!
// TCS Basic is compatible with lower case letters, and basic editing with video terminals is supported.
// Load TCS Basic to RAM.  The first three bytes were originally 0xFF, 0xFF, 0xFF. 
// these were modified to JMP 0100 to enable to start Basic with the "G" command. SWTBUG sets the 
// start address (0xA048 and 0xA049) to 0x0000 after system start!
// Starting the program with "J 0100" is also possible. 
0x7E, 0x01, 0x00, 0xFF, 0xFF, 0xFF, 0xFF, 0xFF, 0xFF, 0xFF, 0xFF, 0xFF, 0xFF, 0xFF, 0xFF, 0xFF,
0xFF, 0xFF, 0xFF, 0xFF, 0xFF, 0xFF, 0xFF, 0xFF, 0xFF, 0xFF, 0xFF, 0xFF, 0xFF, 0xFF, 0xFF, 0xFF,
0xFF, 0xFF, 0xFF, 0xFF, 0xFF, 0xFF, 0xFF, 0xFF, 0xFF, 0xFF, 0xFF, 0xFF, 0xFF, 0xFF, 0xFF, 0xFF,
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0xE2, 0x84, 0x7F, 0xC4, 0x80, 0x1B, 0x97, 0xDF, 0x39, 0x00, 0x00, 0xFF, 0xFF, 0xFF, 0xFF, 0xFF
};

unsigned char RAM_A000_DFFF[0x4000];

int32_t EmulateMC6850(char read_write, char address, char value)
{
  // register definitions;
  static char StatusRegister = 0x02; // read only, set Transmit Data Register Full bit to 1
  static char ControlRegister = 0;   // write only
  static char ReceiveDataRegister;   // read only
  // Transmit Data Register is write only, no allocation is necessary. Data is transfered to Arduinio Serial.write() 

  if(read_write == 1) // read registers
  {
    if (Serial.available() > 0) 
    {
      if((StatusRegister & 0x01) == 0) // Receive Data Register Empty bit
      {
        ReceiveDataRegister = Serial.read();
        StatusRegister |= 0x01; // set receive data register full bit
      } else {
        // Do not allow to overwrite Receive Data Register in MC6850 if multiple
        // bytes are received without reading of receive Data Register.
        Serial.read(); 
      }  
    }
  
    switch(address & 1)
    {
    case 0:
      return StatusRegister;
    case 1:                    // send a byte
      StatusRegister &= 0xFE;  // clear Receive Data Register Empty bit
      return ReceiveDataRegister; 
//      return toupper(ReceiveDataRegister); 
    }        // end read registers
  } else {   // write registers
    switch(address & 1)
    {
    case 0:                    // control register write (write only register)
      if(value == 0x03) {      // reset port!
        StatusRegister = 0x02; // set Transmit Data Register Empty bit to 1
      }
      
      switch((value >> 5) & 3)  // set /RTS output
      {
      case 0:
      case 1:
      case 3:
        digitalWrite(MC6850_RTS, 0);
        break;
        case 2:
        digitalWrite(MC6850_RTS, 1);
        break;
      }
      
      break;
    case 1:
      Serial.flush();          // wait for pending output to complete
      Serial.write(value);
      StatusRegister |= 0x02;  // set Transmit Data Register Empty bit to 1
      break;
    }
  }  // end write registers

  return 0;
}


/*  I/O instruction handlers, called from the MP-B2 module when a
   read or write occur to addresses 0x8004-0x8007. */


int32_t ReadPort(int32_t addr)
{
  char PortValue;
  
  PortValue = 0xFF;

  switch(addr) 
  {
    // Port 1 8004-8007
        /* because each port appears at 2 addresses and this fact is used
	to determine if it is a MP-C or MP-S repeatedly in the SWTBUG
	monitor, this code assures that reads of the high ports return
	the same data as was read the last time on the low ports.
        */
    case 0x8004:
    case 0x8006:
      PortValue = EmulateMC6850(1, 0, 0); // read lower    
      break;
    case 0x8005:
    case 0x8007:
      PortValue = EmulateMC6850(1, 1, 0);    
      break;
    }
    
  return PortValue;
}

void WritePort(int32_t addr, int32_t val)
{
    switch(addr) 
    {
        // Port 1 8004-8007 
        case 0x8004:
        case 0x8006:
            EmulateMC6850(0, 0, (char) val);  // write port    
            break;
        case 0x8005:
        case 0x8007:
            EmulateMC6850(0, 1, (char) val);  // write port    
            break;
    }
}

// Modified Read & Write memory routines added by B. Török
int32_t CPU_BD_get_mbyte(int32_t addr)
{
    int32_t val;

    switch(addr & 0xF000) {
        case 0x0000:
        case 0x1000:
        case 0x2000:
        case 0x3000:
        case 0x4000:
        case 0x5000:
        case 0x6000:
        case 0x7000:
            val = RAM_0000_7FFF[addr] & 0xFF;
            return val;
        case 0x8000:
            return ReadPort(addr);    
        case 0xA000:
        case 0xB000:
        case 0xC000:
        case 0xD000:
            val = RAM_A000_DFFF[addr - 0xA000] & 0xFF;
            return val;
        case 0xE000:
            val = SWTBUG_E000_FFFF[addr - 0xE000] & 0xFF;
            return val;
        case 0xF000:
            val = SWTBUG_E000_FFFF[addr - (0x10000 - sizeof(SWTBUG_E000_FFFF))] & 0xFF;
            return val;
        default:
            return 0xFF;
    }
}

/*  get a word from memory */

int32_t CPU_BD_get_mword(int32_t addr)
{
    int32_t val;

    val = (CPU_BD_get_mbyte(addr) << 8);
    val |= CPU_BD_get_mbyte(addr + 1);
    val &= 0xFFFF;
    return val;
}

/*  put a byte to memory */

void CPU_BD_put_mbyte(int32_t addr, int32_t val)
{
    switch(addr & 0xF000) {
        case 0x0000:
        case 0x1000:
        case 0x2000:
        case 0x3000:
        case 0x4000:
        case 0x5000:
        case 0x6000:
        case 0x7000:
            RAM_0000_7FFF[addr] = (unsigned char) val;
            return;
        case 0x8000:
            WritePort(addr, val);
            return;    
        case 0xA000:
        case 0xB000:
        case 0xC000:
        case 0xD000:
            RAM_A000_DFFF[addr - 0xA000] = (unsigned char) val;
            return;
        default:
            return;
    }
}

/*  put a word to memory */

void CPU_BD_put_mword(int32_t addr, int32_t val)
{
    CPU_BD_put_mbyte(addr, val >> 8);
    CPU_BD_put_mbyte(addr+1, val);
}
// end of Read / Write Memory routines

void WriteToConsole(char* Text)
{
  Serial.println(Text);
}

void setup () 
{
  pinMode(MC6850_RTS, OUTPUT);
  digitalWrite(MC6850_RTS, 0);

  Serial.begin(9600);
  Serial.println ("SWTPC emulation");
  Serial.flush();

  m6800_reset();
//  EmulateMC6850(0, 0, 0x3);  // reset ACIA
}

void memtest()
{
  int i;
  int addr = 0xe000;
  int addr2= 0xa000;
  
  for(i = 1; i < 1024; i++)
  {
    CPU_BD_put_mbyte(addr2, CPU_BD_get_mbyte(addr));    
    if(CPU_BD_get_mbyte(addr) != CPU_BD_get_mbyte(addr2)) {
      Serial.print(addr2, HEX); Serial.print(" "); Serial.println( CPU_BD_get_mword(addr2) , HEX);
    }
    addr++;
    addr2++;
  }
  Serial.println("Byte read/write test completed");
  Serial.println();
  delay(1000);
  for(i = 0; i < 512; i = i + 1)
  {
    CPU_BD_put_mword(addr2, CPU_BD_get_mword(addr));
    
    if(CPU_BD_get_mword(addr) != CPU_BD_get_mword(addr2)) {
      Serial.print( CPU_BD_get_mword(addr2) , HEX);
    }
    addr = addr+2;
    addr2 = addr2+2;
  }
  Serial.println("Word read/write test completed");
  Serial.println();
  delay(1000);
}

void loop () 
{
  int32_t reason;  
  
  reason = sim_instr(1);
//memtest();  // RAM-test, for debug only. 
  Serial.println();
  
  switch(reason)
  {
  case STOP_RSRV:  // This condition is not implemeted in the Arduno emulator
    Serial.println(""); 
    break;
  case STOP_HALT: 
    Serial.println("Opcode WAI executed");
    break;
  case STOP_IBKPT:
    Serial.println("Breakpoint");
    break;
  case STOP_OPCODE:
    Serial.println("Invalid opcode");
    break;
  case STOP_MEMORY:  // This condition is not implemeted in the Arduno emulator
    Serial.println("Invalid memory address");
    break;
  }
  
  Serial.println("\r\nPress Reset to reboot!");
  while(1);

}


